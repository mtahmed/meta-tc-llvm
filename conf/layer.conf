## conf/layer.conf
```bitbake
# We have a conf and classes directory, append to BBPATH
BBPATH .= ":${LAYERDIR}"

# If we have a recipes directory, add to BBFILES
#BBFILES += "${LAYERDIR}/recipes-*/*/*.bb ${LAYERDIR}/*/recipes-*/*/*.bbappend"
#BBFILE_COLLECTIONS += "tc-llvm"
#BBFILE_PATTERN_tc-llvm := "^${LAYERDIR}/"
#BBFILE_PRIORITY_tc-llvm = "5"

PATH := "${PATH}:${LAYERDIR}/bin"

# Define the alternative toolchain llvm.
SECONDARYTC = 'llvm'

# Enable the secondary toolchain.
INHERIT += 'tc-secondary tc-blacklist'
```
